## arch/arm/mach-msm/oneplus/Kconfig
```kconfig
menu "OnePlus board selection"

config MACH_MSM8974_15055
	bool "OnePlus X"
	help
	  Support for the OnePlus X (onyx)

endmenu
```

## drivers/block/zram/Kconfig
```kconfig
config ZRAM
	tristate "Compressed RAM block device support"
	depends on BLOCK && SYSFS && CRYPTO
	select CRYPTO_LZO
	select ZPOOL
	default n
	help
	  Creates virtual block devices called /dev/zramX (X = 0, 1, ...).
	  Pages written to these disks are compressed and stored in memory
	  itself. These disks allow very fast I/O and compression provides
	  good amounts of memory savings.

	  It has several use cases, for example: /tmp storage, use as swap
	  disks and maybe many more.

	  See Documentation/blockdev/zram.txt for more information.

if ZRAM

choice
	prompt "Default zRAM backend"
	default DEFAULT_ZRAM_ZSMALLOC
	help
	  Select the memory allocator that will be used by default to store
	  compressed pages for all zRAM devices.

	config DEFAULT_ZRAM_Z3FOLD
		bool "z3fold" if Z3FOLD=y

	config DEFAULT_ZRAM_ZSMALLOC
		bool "zsmalloc" if ZSMALLOC=y
endchoice

config ZRAM_DEFAULT_BACKEND
	string
	default "z3fold" if DEFAULT_ZRAM_Z3FOLD
	default "zsmalloc"

endif
```
